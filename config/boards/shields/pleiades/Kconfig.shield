## config/boards/shields/pleiades/Kconfig.shield
```kconfig
# Copyright (c) 2022 The ZMK Contributors
# SPDX-License-Identifier: MIT

config SHIELD_PLEIADES_LEFT
    def_bool $(shields_list_contains,pleiades_left)

config SHIELD_PLEIADES_RIGHT
    def_bool $(shields_list_contains,pleiades_right)
```
